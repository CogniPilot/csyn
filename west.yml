## west.yml
```yaml
# SPDX-License-Identifier: Apache-2.0
#
# CI workspace manifest: lets csyn act as its own west manifest repository so
# the module's twister tests build against pinned dependencies on a plain
# GitHub runner (native_sim only, no hardware, no cross toolchains).
# Vehicles consume csyn through their own manifests; nothing imports this one.

manifest:
  self:
    path: modules/lib/csyn

  remotes:
    - name: cognipilot
      url-base: https://github.com/CogniPilot

  projects:
    - name: zephyr
      remote: cognipilot
      revision: c908d12ebc2baa679d0f5b8e31eeb459ea93caff
      path: zephyr
      import: false
    - name: zros
      remote: cognipilot
      revision: 959bce412d6e12b3a49fb8b55c219affcf7f6d0e
      path: modules/lib/zros
```

## zephyr/tests/csyn/basic/testcase.yaml
```yaml
# All integration tests run on native_sim so CI needs no hardware or cross
# toolchains. Board targets may be added under platform_allow for optional
# local runs, but must stay out of integration_platforms.
common:
  tags:
    - csyn
  timeout: 20

tests:
  csyn.basic:
    tags:
      - smoke
    integration_platforms:
      - native_sim
    platform_allow:
      - native_sim
      - native_sim/native/64

  csyn.basic.zros_bridge:
    build_only: true
    integration_platforms:
      - native_sim
    platform_allow:
      - native_sim
      - native_sim/native/64
    extra_configs:
      - CONFIG_ZROS=y
      - CONFIG_POLL=y
      - CONFIG_CSYN_ZROS_BRIDGE=y

  csyn.basic.native_udp:
    build_only: true
    integration_platforms:
      - native_sim
    platform_allow:
      - native_sim
      - native_sim/native/64
    extra_configs:
      - CONFIG_CSYN_NATIVE_UDP=y
      - CONFIG_REQUIRES_FULL_LIBC=y
```
