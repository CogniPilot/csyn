## zephyr/Kconfig
```kconfig
config CSYN
	bool "Enable csyn synapse topic bus"
	default y
	help
	  Enable the csyn topic store: a bounded, lock-free latest-sample
	  store for synapse topics. Payload type, encoding, schema, and catalog
	  id are resolved from the generated synapse_fbs catalog; vehicles
	  declare deployment-specific wire keys. The wire contract is pinned
	  to the locked synapse_fbs release.

if CSYN

config CSYN_FLATBUFFER_MAX_SIZE
	int "Maximum payload size for flatbuffer-encoded topics"
	default 512
	range 64 4096
	help
	  Fixed-layout struct topics size their store slots from the catalog.
	  Flatbuffer topics have variable size and use
	  this bound instead.

config CSYN_ZROS_BRIDGE
	bool "Bridge csyn topics to zros"
	depends on ZROS
	default y
	help
	  Mirror csyn topics onto the in-process zros bus: inbound topics are
	  decoded and published to zros, outbound fixed-layout topics are
	  copied from zros to the csyn store for the active transport.

config CSYN_SHELL
	bool "Enable csyn shell diagnostics"
	depends on SHELL
	default y
	help
	  Adds csyn topic list/info/echo/hz/watch shell commands.

config CSYN_SHELL_THREAD_STACK_SIZE
	int "csyn shell watch thread stack size"
	depends on CSYN_SHELL
	default 2048
	range 1024 8192

config CSYN_NATIVE_UDP
	bool "Enable native_sim csyn UDP transport"
	depends on BOARD_NATIVE_SIM
	default y
	help
	  Add a native_sim-only UDP transport for csyn topic packets. This keeps
	  socket IO in a low-priority thread and outside the controller loop.

config CSYN_NATIVE_UDP_RX_PORT
	int "csyn native_sim UDP RX port"
	depends on CSYN_NATIVE_UDP
	default 4250
	range 1 65535

config CSYN_NATIVE_UDP_TX_PORT
	int "csyn native_sim UDP TX port"
	depends on CSYN_NATIVE_UDP
	default 4251
	range 1 65535

config CSYN_NATIVE_UDP_HOST
	string "csyn native_sim UDP host"
	depends on CSYN_NATIVE_UDP
	default "127.0.0.1"

config CSYN_NATIVE_UDP_THREAD_STACK_SIZE
	int "csyn native_sim UDP thread stack size"
	depends on CSYN_NATIVE_UDP
	default 2048
	range 1024 8192

config CSYN_NATIVE_UDP_THREAD_PRIORITY
	int "csyn native_sim UDP thread priority"
	depends on CSYN_NATIVE_UDP
	default 6

config CSYN_ZENOH
	bool "Enable csyn Zenoh transport"
	depends on NETWORKING || BOARD_NATIVE_SIM
	depends on NET_UDP || BOARD_NATIVE_SIM
	depends on POSIX_API || BOARD_NATIVE_SIM
	select ZENOH_PICO
	select ZENOH_PICO_PUBLICATION
	select ZENOH_PICO_SUBSCRIPTION
	select ZENOH_PICO_QUERY
	select ZENOH_PICO_QUERYABLE
	help
	  Subscribe to inbound synapse topics over Zenoh and publish outbound
	  topics over Zenoh. This is the flight transport for the
	  Ethernet-only board path. The link, discovery, and threading posture
	  are chosen with CSYN_ZENOH_POSTURE and CSYN_ZENOH_MULTI_THREAD rather
	  than forced on, so a board can build a lean point-to-point client.

config CSYN_ZENOH_MULTI_THREAD
	bool "Service the Zenoh session on dedicated read and lease tasks"
	depends on CSYN_ZENOH
	default y
	select ZENOH_PICO_MULTI_THREAD
	help
	  Start the zenoh-pico background read and lease tasks so the session
	  runs off dedicated threads. Disable to build a single-thread client
	  that services the session inline from the csyn zenoh thread, dropping
	  the two background threads and their stacks. The task API is only
	  compiled when this is set, so the same symbol picks the inline
	  single-thread service loop when it is cleared.

choice CSYN_ZENOH_POSTURE
	prompt "csyn Zenoh link and discovery posture"
	depends on CSYN_ZENOH
	default CSYN_ZENOH_POSTURE_TCP_CLIENT
	help
	  Selects which zenoh-pico link and discovery code is compiled in. The
	  session mode and locator are set separately with CSYN_ZENOH_MODE and
	  CSYN_ZENOH_LOCATOR. This choice only decides which links are built.

config CSYN_ZENOH_POSTURE_TCP_CLIENT
	bool "TCP client (no scouting, no UDP multicast)"
	select ZENOH_PICO_LINK_TCP
	help
	  Point-to-point TCP session to a fixed router locator such as
	  tcp/10.58.0.1:7447. No UDP unicast, UDP multicast, or scouting code is
	  compiled, so the build carries no multicast-listener path and no IPv6
	  multicast-group (MLD) dependency.

config CSYN_ZENOH_POSTURE_UDP_UNICAST
	bool "UDP unicast client (no scouting, no UDP multicast)"
	select ZENOH_PICO_LINK_UDP_UNICAST
	help
	  Point-to-point UDP session to a fixed peer locator such as
	  udp/192.0.2.2:7447, used by the native_sim SITL side-channel. No
	  multicast or scouting code is compiled.

config CSYN_ZENOH_POSTURE_UDP_MULTICAST
	bool "UDP multicast with scouting"
	select ZENOH_PICO_LINK_UDP_UNICAST
	select ZENOH_PICO_LINK_UDP_MULTICAST
	select ZENOH_PICO_SCOUTING
	help
	  Peer and discovery posture that uses UDP multicast scouting. This
	  compiles the multicast-listener path, which joins IPv6 multicast
	  groups and therefore needs NET_IPV6 and NET_IPV6_MLD in the network
	  stack.

endchoice

config CSYN_ZENOH_MODE
	string "csyn Zenoh mode"
	depends on CSYN_ZENOH
	default "client"

config CSYN_ZENOH_LOCATOR
	string "csyn Zenoh connect/listen locator"
	depends on CSYN_ZENOH
	default "udp/192.0.2.2:7447"

config CSYN_NAMESPACE
	string "Default deployment namespace for bare csyn Zenoh keys"
	depends on CSYN_ZENOH
	default ""
	help
	  Optional deployment namespace, e.g. "cub1": topics declared with a
	  bare catalog key publish and subscribe as <namespace>/<key>. A topic
	  declared with a namespaced key such as vicon/cub1/odom uses that key
	  verbatim. Queryable service keys always use this default namespace.
	  Multi-segment namespaces such as "lab/cub1" are allowed; do not use
	  leading or trailing slashes.

choice CSYN_MOCAP_SOURCE
	prompt "Stream feeding the zros mocap topic"
	default CSYN_MOCAP_SOURCE_FRAME
	depends on CSYN_ZROS_BRIDGE

config CSYN_MOCAP_SOURCE_FRAME
	bool "mocap topic rigid bodies"
	help
	  Decode the selected rigid body from synapse.topic.MocapPoseFrame
	  payloads on the canonical mocap key: raw measurements, closest to
	  the direct pose stream the controller was tuned against. Also accepts
	  the legacy 28-byte compact pose on CSYN_ZENOH_MOCAP_POSE_KEY.

config CSYN_MOCAP_SOURCE_POSE_KEY
	bool "direct compact pose key"
	help
	  Only the CSYN_ZENOH_MOCAP_POSE_KEY subscription feeds the mocap
	  topic (legacy per-body compact pose stream, e.g. the electrode
	  ground station republisher).

config CSYN_MOCAP_SOURCE_ODOMETRY
	bool "odom estimator output"
	help
	  Derive the mocap pose from the OdometryData topic declared by the
	  vehicle with CSYN_TOPIC_DEFINE.
	  The bridge estimator extrapolates through tracking gaps, so
	  consumers tuned for raw poses will not see repeated/held samples
	  during dropouts.

endchoice

config CSYN_MOCAP_RIGID_BODY_ID
	int "Rigid-body id selected from MocapPoseFrame payloads"
	depends on CSYN_ZROS_BRIDGE
	default 0
	help
	  QTM 6D rigid-body ids are 1-based; 0 selects the first body in
	  each frame.

config CSYN_ZENOH_MOCAP_POSE_KEY
	string "Zenoh key of a raw pose stream fed into the mocap topic"
	depends on CSYN_ZENOH
	default ""

config CSYN_ZENOH_MOCAP_SELECTED_HOLD_SAMPLES
	int "Fallback mocap samples suppressed after each fresh selected/ pose"
	depends on CSYN_ZENOH
	default 48

config CSYN_ZENOH_RETRY_MS
	int "csyn Zenoh reconnect period in milliseconds"
	depends on CSYN_ZENOH
	default 1000
	range 100 10000

config CSYN_ZENOH_THREAD_STACK_SIZE
	int "csyn Zenoh thread stack size"
	depends on CSYN_ZENOH
	default 6144
	range 2048 16384

config CSYN_ZENOH_THREAD_PRIORITY
	int "csyn Zenoh thread priority"
	depends on CSYN_ZENOH
	default 5

endif
```
